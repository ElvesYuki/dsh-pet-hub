## firmware/devices/esp32s3-touch-amoled-175c/main/Kconfig.projbuild
```kconfig
config MUSE_VIDEO_VP8
    bool
    default y
config MUSE_VIDEO_DECODER_IRAM
    bool
    default y
config PET_BOARD_175C
    bool
    default y
```
